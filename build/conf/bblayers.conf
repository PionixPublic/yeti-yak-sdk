## build/conf/bblayers.conf
```bitbake
# POKY_BBLAYERS_CONF_VERSION is increased each time build/conf/bblayers.conf
# changes incompatibly
POKY_BBLAYERS_CONF_VERSION = "2"

BBPATH = "${TOPDIR}"
BBFILES ?= ""

OEROOT := "${@os.path.abspath(os.path.dirname(d.getVar('FILE', True)) + '/..')}"
YETI_YAK_SOURCE_DIR := "../../yeti-yak-sdk-source"

BBLAYERS ?= " \
  ${OEROOT}/${YETI_YAK_SOURCE_DIR}/poky/meta \
  ${OEROOT}/${YETI_YAK_SOURCE_DIR}/poky/meta-poky \
  ${OEROOT}/${YETI_YAK_SOURCE_DIR}/poky/meta-yocto-bsp \
  ${OEROOT}/${YETI_YAK_SOURCE_DIR}/meta-arm/meta-arm \
  ${OEROOT}/${YETI_YAK_SOURCE_DIR}/meta-arm/meta-arm-toolchain \
  ${OEROOT}/${YETI_YAK_SOURCE_DIR}/meta-raspberrypi \
  ${OEROOT}/${YETI_YAK_SOURCE_DIR}/meta-openembedded/meta-oe \
  ${OEROOT}/${YETI_YAK_SOURCE_DIR}/meta-openembedded/meta-multimedia \
  ${OEROOT}/${YETI_YAK_SOURCE_DIR}/meta-openembedded/meta-networking \
  ${OEROOT}/${YETI_YAK_SOURCE_DIR}/meta-openembedded/meta-python \
  ${OEROOT}/../meta-yeti-yak \
  ${OEROOT}/${YETI_YAK_SOURCE_DIR}/meta-everest \
  ${OEROOT}/${YETI_YAK_SOURCE_DIR}/meta-clang \
  "
```

## meta-yeti-yak/conf/layer.conf
```bitbake
# We have a conf and classes directory, add to BBPATH
BBPATH .= ":${LAYERDIR}"

# We have recipes-* directories, add to BBFILES
BBFILES += "${LAYERDIR}/recipes-*/*/*.bb \
            ${LAYERDIR}/recipes-*/*/*.bbappend"

BBFILE_COLLECTIONS += "meta-yeti-yak"
BBFILE_PATTERN_meta-yeti-yak = "^${LAYERDIR}/"
BBFILE_PRIORITY_meta-yeti-yak = "99"

LAYERDEPENDS_meta-yeti-yak = "meta-everest"
LAYERSERIES_COMPAT_meta-yeti-yak = "kirkstone"
```
